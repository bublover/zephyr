## subsys/net/l2/ieee80211/Kconfig
```kconfig
menuconfig NET_L2_IEEE80211
	bool "Enable IEEE 802.11"
	help
	  Add support for IEEE 802.11 technology.

if NET_L2_IEEE80211

module = NET_L2_IEEE80211
module-dep = NET_LOG
module-str = Log level for IEEE 802.11 L2 layer
module-help = Enables IEEE 802.11 L2 to output debug messages.
source "subsys/net/Kconfig.template.log_config.net"

config NET_ARP
	bool "Enable ARP"
	default y
	depends on NET_IPV4
	help
	  Enable ARP support. This is necessary on hardware that requires it to
	  get IPv4 working (like Ethernet devices).


config NET_ARP_TABLE_SIZE
	int "Number of entries in ARP table."
	depends on NET_ARP
	default 2
	help
	  Each entry in the ARP table consumes 22 bytes of memory.

config NET_ARP_GRATUITOUS
	bool "Support gratuitous ARP requests/replies."
	depends on NET_ARP
	default y
	help
	  Gratuitous in this case means a ARP request or reply that is not
	  normally needed according to the ARP specification but could be used
	  in some cases. A gratuitous ARP request is a ARP request packet where
	  the source and destination IP are both set to the IP of the machine
	  issuing the packet and the destination MAC is the broadcast address
	  ff:ff:ff:ff:ff:ff. Ordinarily, no reply packet will occur.
	  A gratuitous ARP reply is a reply to which no request has been made.

endif # NET_L2_IEEE80211
```
